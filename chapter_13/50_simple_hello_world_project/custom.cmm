// SPDX-License-Identifier: MIT
// Copyright (c) 2026 YOUNGJIN JOO (neoelec@gmail.com)

B::

ON ERROR DO &G_RCN_Path/error.cmm

PRIVATE &E_Func &E_Args
ENTRY &E_Func %LINE &E_Args
PRIVATE &ret

DO ../../prj_custom.cmm &E_Func &E_Args
ENTRY %LINE &ret

ENDDO &ret
